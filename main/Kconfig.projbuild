## main/Kconfig.projbuild
```kconfig
menu "Wifi Credentials"

    config WIFI_SSID
        string "wifi ssid"
        default NULL

    config WIFI_PASS
        string "wifi password"
        default NULL

endmenu

menu "AI Configuration"

    config AI_ENABLED
        bool "Use AI"
        default n

    config AI_IMAGE_WIDTH
        int "AI image Width"
        default 512

    config AI_IMAGE_HEIGHT
        int "AI image Height"
        default 512

    config AI_IMAGE_CHANNELS
        int "AI image Channels"
        default 3

endmenu

menu "Websocket Configuration"

    choice IP_MODE
        prompt "IP Version"
        help
            Example can use either IPV4 or IPV6.

        config IPV4
            bool "IPV4"

        config IPV6
            bool "IPV6"
            select CONNECT_IPV6

    endchoice

    config SOCKET_IPV4_ADDR
        string "IPV4 Address"
        default "192.168.43.170"
        depends on IPV4
        help
            IPV4 address to which the client will send data.

    config SOCKET_IPV6_ADDR
        string "IPV6 Address"
        default "FE80::30AD:E57B:C212:68AD"
        depends on IPV6
        help
            IPV6 address to which the client will send data.

    config SOCKET_PORT
        int "Port"
        range 0 65535
        default 8765
        help
            The remote port to which the client will send data.

endmenu
```
